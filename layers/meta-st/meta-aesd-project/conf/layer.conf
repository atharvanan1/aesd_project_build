## layers/meta-st/meta-aesd-project/conf/layer.conf
```bitbake
# We have a conf and classes directory, add to BBPATH
BBPATH .= ":${LAYERDIR}"

# We have recipes-* directories, add to BBFILES
BBFILES += "${LAYERDIR}/recipes-*/*/*.bb \
            ${LAYERDIR}/recipes-*/*/*.bbappend"

BBFILE_COLLECTIONS += "meta-aesd-project"
BBFILE_PATTERN_meta-aesd-project = "^${LAYERDIR}/"
BBFILE_PRIORITY_meta-aesd-project = "9"

# This should only be incremented on significant changes that may
# cause compatibility issues with other layers
LAYERVERSION_meta-aesd-project = "1"
LAYERDEPENDS_meta-aesd-project = " \
	core \
	stm-st-stm32mp-mx \
	openembedded-layer \
	meta-python \
	networking-layer \
	"
LAYERSERIES_COMPAT_meta-aesd-project = "thud"

EULA_FILE_ST_stm32mpaesd = "${LAYERDIR}/conf/eula/${MACHINE}"
EULA_FILE_ST_MD5SUM_stm32mpaesd = "8b505090fb679839cefbcc784afe8ce9"

#Inform bitbake for adding another location to search for licenses
LICENSE_PATH += "${LAYERDIR}/files/licenses"

# Set a variable to get the STM32MP MX BSP location
STM32MP_AESD_PROJECT = "${LAYERDIR}"

# Solution for qtwayland configuration errors
# https://github.com/Igalia/meta-webkit/issues/132
PACKAGECONFIG_remove_pn-qtwayland = "xcomposite-glx"
```
